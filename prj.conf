## CMakeLists.txt
```
# SPDX-License-Identifier: Apache-2.0

cmake_minimum_required(VERSION 3.20.0)

find_package(Zephyr REQUIRED HINTS $ENV{ZEPHYR_BASE})
project(xlfirmware)

target_sources(app PRIVATE src/main.c)
```

## west.yml
```
# Copyright (c) 2024 Xili
# SPDX-License-Identifier: Apache-2.0

manifest:
  version: 0.13
  remotes:
    - name: zephyrproject-rtos
      url-base: https://github.com/zephyrproject-rtos
    - name: openbmc
      url-base: https://github.com/openbmc

  projects:
    - name: libpldm
      remote: openbmc
      path: modules/lib/libpldm
      revision: 1c4a11442648a7ac670167b4d306a70376a35cc2
    - name: zephyr
      remote: zephyrproject-rtos
      repo-path: zephyr
      revision: v4.4.0
      path: zephyr
      import:
        name-allowlist:
          - hal_rpi_pico
          - cmsis_6
          - hal_stm32
          - libmctp
          - mbedtls
          - mcuboot
          - nanopb
          - segger
          - tf-psa-crypto

  group-filter:
    - +optional
```

## prj.conf
```kconfig
# 基本配置
CONFIG_SERIAL=y
CONFIG_CONSOLE=y

# 打印输出
CONFIG_PRINTK=y

# GPIO 驱动
CONFIG_GPIO=y
```

## src/main.c
```c
/*
 * SPDX-License-Identifier: Apache-2.0
 */

#include <zephyr/kernel.h>
#include <zephyr/device.h>
#include <zephyr/drivers/gpio.h>
#include <stdio.h>

/* 板载 LED（如果 devicetree 中有定义） */
#if DT_NODE_EXISTS(DT_ALIAS(led0))
static const struct gpio_dt_spec led = GPIO_DT_SPEC_GET(DT_ALIAS(led0), gpios);
#endif

int main(void)
{
	int ret;

	printf("xlfirmware starting...\n");
	printf("Board: %s\n", CONFIG_BOARD);

#if DT_NODE_EXISTS(DT_ALIAS(led0))
	if (!device_is_ready(led.port)) {
		printf("Error: LED device not ready\n");
		return 1;
	}

	ret = gpio_pin_configure_dt(&led, GPIO_OUTPUT_ACTIVE);
	if (ret < 0) {
		printf("Error: failed to configure LED pin (%d)\n", ret);
		return 1;
	}
	printf("LED configured, starting blink...\n");
#else
	printf("No LED defined in devicetree, running in simulation mode...\n");
#endif

	while (1) {
#if DT_NODE_EXISTS(DT_ALIAS(led0))
		gpio_pin_toggle_dt(&led);
		printf("LED %s\n", gpio_pin_get_dt(&led) ? "ON" : "OFF");
#else
		printf("Tick...%d...\n", ret++);
#endif
		k_sleep(K_MSEC(1000));
	}

	return 0;
}
```
